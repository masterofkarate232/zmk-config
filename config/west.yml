## config/west.yml
```yaml
manifest:
  remotes:
    - name: zmkfirmware
      url-base: https://github.com/zmkfirmware
    - name: masterofkarate232
      url-base: https://github.com/masterofkarate232
    - name: m165437 #new entry
      url-base: https://github.com/M165437 #new entry
    - name: kevinpastor
      url-base: https://github.com/kevinpastor
    - name: infely                             
      url-base: https://github.com/infely      
    
  projects:
    - name: zmk
      remote: zmkfirmware
 #     revision: main
      revision: v0.3.0
      import: app/west.yml
#    - name: nice-view-gem-layer-name
#      remote: masterofkarate232
#      revision: main
    - name: nice-view-gem #new entry
      remote: m165437 #new entry
#      revision: main #new entry
      revision: v0.3.0
    - name: nice-view-elemental
      remote: kevinpastor
      revision: main
    - name: nice-view-battery                
      remote: infely                         
      revision: main                         

  self:
    path: config   
```
